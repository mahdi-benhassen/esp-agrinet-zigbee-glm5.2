## esp-agrinet-zigbee-glm5.2/rcp/sdkconfig.defaults
```kconfig
# ESP32-H2 Radio Coprocessor (RCP) configuration
#
# The ESP32-H2 firmware that runs on the gateway's radio side.
# It uses esp-hosty / esp-zigbee-sdk's RCP example which we don't
# duplicate here - instead we provide the sdkconfig and CMake
# wrappers needed to build it.
#
# In production, use esp-zigbee-sdk/examples/esp_zigbee_gw/rcp and
# flash that to the ESP32-H2 of the gateway. This folder keeps the
# sdkconfig.defaults used in this project's CI.

CONFIG_IDF_TARGET="esp32h2"
CONFIG_ZB_ENABLED=y
CONFIG_ZB_RCP=y
CONFIG_ZB_CHANNEL=15
CONFIG_ZB_TX_POWER=20
CONFIG_ESP_CONSOLE_UART_DEFAULT=y
CONFIG_ESP_CONSOLE_UART_CUSTOM=y
CONFIG_ESP_CONSOLE_UART_CUSTOM_NUM=1
CONFIG_ESP_CONSOLE_SECONDARY_USB_SERIAL_JTAG=n
```

## gateway/host/sdkconfig.defaults
```kconfig
# Gateway (ESP32-S3 host) sdkconfig defaults
# Target: ESP32-S3

CONFIG_IDF_TARGET="esp32s3"

# Zigbee gateway (host) configuration - ESP32-H2 RCP over UART1
CONFIG_ZB_ENABLED=y
CONFIG_ZB_SDK_1xx=y
CONFIG_ZB_ZCZR=y
CONFIG_ZB_RADIO_SPINEL_UART=y

# WiFi
CONFIG_ESP_WIFI_ENABLED=y
CONFIG_ESP_WIFI_MODE_STA=y
CONFIG_ESP_WIFI_MODE_AP=y
CONFIG_ESP_WIFI_STA_RECONNECT=y

# MQTT
CONFIG_MQTT_PROTOCOL_311=y
CONFIG_MQTT_BUFFER_SIZE=1024

# Partition
CONFIG_PARTITION_TABLE_CUSTOM=y
CONFIG_PARTITION_TABLE_CUSTOM_FILENAME="partitions.csv"
CONFIG_PARTITION_TABLE_OFFSET=0x8000

# Flash size (ESP32-S3 DevKitC-1 has 8MB)
CONFIG_ESPTOOLPY_FLASHSIZE_8MB=y
CONFIG_ESPTOOLPY_FLASHSIZE="8MB"

# PSRAM on the ESP32-S3 DevKitC-1
CONFIG_SPIRAM=y
CONFIG_SPIRAM_BOOT_INIT=y
CONFIG_SPIRAM_USE_MALLOC=y
CONFIG_SPIRAM_TRY_ALLOCATE_WIFI_LWIP=y

# Console
CONFIG_ESP_CONSOLE_UART_DEFAULT=y
CONFIG_ESP_LOG_DEFAULT_LEVEL_INFO=y
CONFIG_ESP_LOG_LEVEL_INFO=y
CONFIG_LOG_COLORS=y

# NVS
CONFIG_NVS_ENCRYPTION=n

# FreeRTOS
CONFIG_FREERTOS_HZ=100

# Watchdog
CONFIG_ESP_TASK_WDT_INIT=y
CONFIG_ESP_TASK_WDT_TIMEOUT_S=30
```

## gateway/rcp/sdkconfig.defaults
```kconfig
# ESP-AgriNet RCP additional configuration
#
# This file is APPENDED to ESP-IDF's ot_rcp example sdkconfig.defaults.
# Do not overwrite the example's defaults — the ot_rcp example needs its
# own settings (size optimisation, openthread enable, etc.) to compile.
#
# The only setting we add is the Zigbee vendor hook, which extends the
# OpenThread RCP with the Spinel properties used by the ESP Zigbee gateway
# host firmware to manage a Zigbee network through the H2 radio.

CONFIG_OPENTHREAD_NCP_VENDOR_HOOK=y
```

## nodes/actuator_node/sdkconfig.defaults
```kconfig
# Actuator node sdkconfig defaults
# Target: ESP32-H2

CONFIG_IDF_TARGET="esp32h2"

# Zigbee router (mains-powered)
CONFIG_ZB_ENABLED=y
CONFIG_ZB_ROUTER=y
CONFIG_ZB_CHANNEL=15
CONFIG_ZB_PAN_ID=0x1A2B
CONFIG_ZB_TX_POWER=20

# Console
CONFIG_ESP_CONSOLE_UART_DEFAULT=y
CONFIG_ESP_LOG_DEFAULT_LEVEL_INFO=y
CONFIG_ESP_LOG_LEVEL_INFO=y
CONFIG_LOG_COLORS=y

# LEDC
CONFIG_LEDC_CTRL_FUNC_IN_IRAM=y

# Partition
CONFIG_PARTITION_TABLE_CUSTOM=y
CONFIG_PARTITION_TABLE_CUSTOM_FILENAME="partitions.csv"
CONFIG_PARTITION_TABLE_OFFSET=0x8000

# Flash size (ESP32-H2 DevKitM-1 has 4MB)
CONFIG_ESPTOOLPY_FLASHSIZE_4MB=y
CONFIG_ESPTOOLPY_FLASHSIZE="4MB"

# NVS
CONFIG_NVS_ENCRYPTION=n

# FreeRTOS
CONFIG_FREERTOS_HZ=100

# Watchdog
CONFIG_ESP_TASK_WDT_INIT=y
CONFIG_ESP_TASK_WDT_TIMEOUT_S=30
```

## nodes/sensor_node/sdkconfig.defaults
```kconfig
# Sensor node sdkconfig defaults
# Target: ESP32-H2

CONFIG_IDF_TARGET="esp32h2"

# Zigbee end-device
CONFIG_ZB_ENABLED=y
CONFIG_ZB_END_DEVICE=y
CONFIG_ZB_CHANNEL=15
CONFIG_ZB_PAN_ID=0x1A2B
CONFIG_ZB_TX_POWER=20

# Console on USB-Serial-JTAG (ESP32-H2 has no native USB but DevKitM exposes UART0 via USB bridge)
CONFIG_ESP_CONSOLE_UART_DEFAULT=y
CONFIG_ESP_LOG_DEFAULT_LEVEL_INFO=y
CONFIG_ESP_LOG_LEVEL_INFO=y
CONFIG_LOG_COLORS=y

# I2C
CONFIG_I2C_MASTER_ENABLED=y
CONFIG_I2C_MASTER_FIFO_LEN=128

# ADC
CONFIG_ADC_ONESHOT=y
CONFIG_ADC_CONTINUOUS=y
CONFIG_ADC_CAL_EFUSE_TP_ENABLE=y
CONFIG_ADC_CAL_EFUSE_VREF_ENABLE=y

# Power management - light sleep allowed for battery operation
CONFIG_FREERTOS_USE_TICKLESS_IDLE=y
CONFIG_PM_ENABLE=y
CONFIG_PM_DFS_INIT_AUTO=y

# Partition
CONFIG_PARTITION_TABLE_CUSTOM=y
CONFIG_PARTITION_TABLE_CUSTOM_FILENAME="partitions.csv"
CONFIG_PARTITION_TABLE_OFFSET=0x8000

# Flash size (ESP32-H2 DevKitM-1 has 4MB)
CONFIG_ESPTOOLPY_FLASHSIZE_4MB=y
CONFIG_ESPTOOLPY_FLASHSIZE="4MB"

# NVS
CONFIG_NVS_ENCRYPTION=n

# FreeRTOS
CONFIG_FREERTOS_HZ=100

# Watchdog
CONFIG_ESP_TASK_WDT_INIT=y
CONFIG_ESP_TASK_WDT_TIMEOUT_S=60
```

## rcp/sdkconfig.defaults
```kconfig
# ESP32-H2 Radio Coprocessor (RCP) configuration
#
# Built from ESP-IDF examples/openthread/ot_rcp with the Zigbee vendor hook.
# The CI workflow copies this file into the ot_rcp example directory before
# building.
#
# The key option is OPENTHREAD_NCP_VENDOR_HOOK which adds the Zigbee-specific
# Spinel hooks needed by the ESP Zigbee gateway host firmware.

CONFIG_IDF_TARGET="esp32h2"

# Enable Zigbee vendor hook in the OpenThread RCP
CONFIG_OPENTHREAD_NCP_VENDOR_HOOK=y

# UART console on UART0 (USB bridge on DevKitM)
CONFIG_ESP_CONSOLE_UART_DEFAULT=y

# Size-optimisation defaults (matching ot_rcp example)
CONFIG_COMPILER_OPTIMIZATION_SIZE=y
CONFIG_COMPILER_OPTIMIZATION_ASSERTIONS_SILENT=y
CONFIG_COMPILER_OPTIMIZATION_CHECKS_SILENT=y
CONFIG_ESP_ERR_TO_NAME_LOOKUP=n
CONFIG_ESP_SYSTEM_PANIC_SILENT_REBOOT=y
CONFIG_LOG_DEFAULT_LEVEL_NONE=y
CONFIG_LIBC_NEWLIB_NANO_FORMAT=y
CONFIG_OPENTHREAD_LOG_LEVEL_DYNAMIC=n
CONFIG_OPENTHREAD_LOG_LEVEL_NONE=y
```
